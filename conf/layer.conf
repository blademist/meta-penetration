## conf/layer.conf
```bitbake
BBPATH .= ":${LAYERDIR}"

BBFILES += "${LAYERDIR}/recipes-*/*/*.bb \
            ${LAYERDIR}/recipes-*/*/*.bbappend"

BBFILE_COLLECTIONS += "penetration-tools"
BBFILE_PATTERN_penetration-tools = "^${LAYERDIR}/"
BBFILE_PRIORITY_penetration-tools = "6"

LAYERVERSION_penetration-tools = "1"

LAYERDEPENDS_penetration-tools = "core"
LAYERDEPENDS_penetration-tools += "openembedded-layer"
LAYERDEPENDS_penetration-tools += "networking-layer"
# Only fern-wifi-cracker requires python3-pyqt5 which is in meta-qt5.
#LAYERDEPENDS_penetration-tools += "qt5-layer"

LAYERSERIES_COMPAT_penetration-tools = "langdale"
```
